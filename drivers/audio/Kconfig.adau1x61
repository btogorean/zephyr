## drivers/audio/Kconfig.adau1x61
```kconfig
# Copyright (C) 2020 Analog Devices Inc.
# SPDX-License-Identifier: Apache-2.0

config AUDIO_ADAU1x61
	bool "ADAU1x61 DAC support"
	depends on I2C
	help
	  Enable Analog Devices ADAU1361/1761/1961 support on the selected board

if AUDIO_ADAU1x61

config AUDIO_ADAU1x61_HP_ENABLE
	bool "Headphones Output"

config AUDIO_ADAU1x61_LINE_ENABLE
	bool "Line Output"

config AUDIO_ADAU1x61_CLK_SRC_PLL
	bool "Clock source PLL"

config AUDIO_ADAU1x61_PLL_IN_FREQ
	depends on AUDIO_ADAU1x61_CLK_SRC_PLL
	int "PLL input CLK in Hz"
	default 12000000
	range 8000000 27000000

endif # AUDIO_ADAU1x61
```
